#include <dt-bindings/gpio/gpio.h>
#include <dt-bindings/pinctrl/bcm2835.h>
#include <dt-bindings/input/input.h>

&gpio {
	sue_pins: sue_pins {
		brcm,pins = <27>;
		brcm,function = <BCM2835_FSEL_GPIO_IN>;
		brcm,pull = <BCM2835_PUD_DOWN>;
	};
};

&spi0 {
	sue_creek: sof-sue-creek@0 {
		reg = <0>;
		compatible = "sof,sue-creek";

		pinctrl-names = "default";
		pinctrl-0 = <&sue_pins>;

		// FIXME: frequency value
		spi-max-frequency = <54000000>;
		fw_filename = "intel/sof-spi.ri";
		tplg_filename = "intel/sof-spi.tplg";
		// FIXME: GPIO controller and IRQ number and sense
		interrupt-parent = <&gpio>;
		interrupts = <27 IRQ_TYPE_EDGE_RISING>;
		reset-gpios = <&gpio 22 GPIO_ACTIVE_LOW>;
	};
};
