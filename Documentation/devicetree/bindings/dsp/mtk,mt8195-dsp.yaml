## Documentation/devicetree/bindings/dsp/mtk,mt8195-dsp.yaml
```yaml
# SPDX-License-Identifier: (GPL-2.0 OR BSD-2-Clause)
%YAML 1.2
---
$id: http://devicetree.org/schemas/dsp/mtk,mt8195-dsp.yaml#
$schema: http://devicetree.org/meta-schemas/core.yaml#

title: Mediatek mt8195 DSP core

maintainers:
  - YC Hung <yc.hung@mediatek.com>

description: |
  Some boards from mt8195 contain a DSP core used for
  advanced pre- and post- audio processing.

properties:
  compatible:
    const: mediatek,mt8195-audio_dsp

  reg:
    maxItems: 5

  reg-names:
    maxItems: 5

  interrupts:
    maxItems: 4

  interrupt-names:
    maxItems: 4

  clocks:
    items:
      - description: mux for dsp clock
      - description: 26M clock
      - description: mux for audio dsp local bus
      - description: default audio dsp local bus clock source
      - description: clock gate for dsp clock
      - description: mux for dsp access external bus

  clock-names:
    items:
      - const: dsp_sel
      - const: clk26m_ck
      - const: audio_local_bus
      - const: mainpll_d7_d2
      - const: scp_adsp_audiodsp
      - const: audio_h_sel

  power-domains:
    maxItems: 1

  mboxes:
    maxItems: 3

  mbox-names:
    items:
      - const: adsp 0
      - const: adsp 1
      - const: adsp 2

  "#mbox-cells":
    const: 1
    description:
      The first cell is the client-id, and the second cell is the signal-id.

  sound:
    maxItems: 3

  memory-region:
    description:
      phandle to a node describing reserved memory (System RAM memory)
      used by DSP (see bindings/reserved-memory/reserved-memory.txt)
    maxItems: 2

required:
  - compatible
  - reg
  - clocks
  - clock-names
  - power-domains
  - mboxes
  - mbox-names
  - memory-region
  - "#mbox-cells"

additionalProperties: false

examples:
  - |
    #include <dt-bindings/interrupt-controller/arm-gic.h>
    #include <dt-bindings/interrupt-controller/irq.h>

    adsp: adsp@10803000 {
       compatible =  "mediatek,mt8195-audio_dsp";
       reg = <0x10803000  0x1000>,
             <0x10840000  0x40000>,
             <0x10816000  0x1000>,
             <0x10817000  0x1000>,
             <0x10818000  0x1000>;
       reg-names = "cfg", "sram", "mbox0", "mbox1", "mbox2";
       interrupts = <GIC_SPI 694 IRQ_TYPE_LEVEL_HIGH 0>,
                    <GIC_SPI 702 IRQ_TYPE_LEVEL_HIGH 0>,
                    <GIC_SPI 703 IRQ_TYPE_LEVEL_HIGH 0>,
                    <GIC_SPI 704 IRQ_TYPE_LEVEL_HIGH 0>;
       interrupt-names = "wdt", "mbox0", "mbox1", "mbox2";
       clocks = <&topckgen 10>, //CLK_TOP_DSP_SEL
                <&clk26m>,
                <&topckgen 107>, //CLK_TOP_AUDIO_LOCAL_BUS_SEL
                <&topckgen 136>, //CLK_TOP_MAINPLL_D7_D2
                <&scp_adsp 0>, //CLK_SCP_ADSP_AUDIODSP
                <&topckgen 34>; //CLK_TOP_AUDIO_H_SEL
       clock-names = "dsp_sel",
                     "clk26m_ck",
                     "audio_local_bus",
                     "mainpll_d7_d2",
                     "scp_adsp_audiodsp",
                     "audio_h_sel";
       memory-region = <&adsp_dma_mem_reserved>,
                       <&adsp_mem_reserved>;
       power-domains = <&spm 6>; //MT8195_POWER_DOMAIN_ADSP
       #mbox-cells = <1>;
       mboxes = <&adsp 0>, <&adsp 1>, <&adsp 2>;
       status = "disabled";

       sound {
              mediatek,dptx-codec = <&dp_tx>;
              mediatek,hdmi-codec = <&hdmi0>;
              mediatek,platform = <&afe>;
             };
       };
```

## Documentation/devicetree/bindings/sound/everest,es8326.yaml
```yaml
# SPDX-License-Identifier: (GPL-2.0-only OR BSD-2-Clause)
%YAML 1.2
---
$id: http://devicetree.org/schemas/sound/everest,es8326.yaml#
$schema: http://devicetree.org/meta-schemas/core.yaml#

title: Everest ES8326 audio CODEC

maintainers:
  - David Yang <yangxiaohua@everest-semi.com>

properties:
  compatible:
    const: everest,es8326

  reg:
    maxItems: 1

  clocks:
    items:
      - description: clock for master clock (MCLK)

  clock-names:
    items:
      - const: mclk

  "#sound-dai-cells":
    const: 0

  mclk-rate:
    description:
      clock rate of mclk
    $ref: /schemas/types.yaml#/definitions/uint32-array
    minItems: 1

  everest,jack-pol:
    description:
      just the value of reg 57. Bit(3) decides whether the jack polarity is inverted.
      Bit(2) decides whether the bottom on the headset is inverted.
      Bit(1)/(0) decides the mic properity to be OMTP/CTIA or auto.
    $ref: /schemas/types.yaml#/definitions/uint8-array
    minimum: 0
    maximum: 0x0f
    default: 0x0f
  
  everest,mic1-src:
    description:
      the value of reg 2A when headset plugged.
    $ref: /schemas/types.yaml#/definitions/uint8-array
    minimum: 0x00
    maximum: 0x77
    default: 0x22

  everest,mic2-src:
    description:
      the value of reg 2A when headset unplugged.
    $ref: /schemas/types.yaml#/definitions/uint8-array
    minimum: 0x00
    maximum: 0x77
    default: 0x44

  everest,amic1-src:
    description:
      the value of reg 23 when headset plugged.
    $ref: /schemas/types.yaml#/definitions/uint8-array
    minimum: 0x19
    maximum: 0x29
    default: 0x19

  everest,amic2-src:
    description:
      the value of reg 23 when headset unplugged.
      Set to 0x19 if dmic used. Set to 0x29 if amic used.
    $ref: /schemas/types.yaml#/definitions/uint8-array
    minimum: 0x19
    maximum: 0x29
    default: 0x19

  everest,jack-detect-inverted:
    description:
      Defined to invert the jack detection.
    $ref: /schemas/types.yaml#/definitions/flag

required:
  - compatible
  - reg
  - "#sound-dai-cells"


additionalProperties: false

examples:
  - |
    i2c0 {
      #address-cells = <1>;
      #size-cells = <0>;
      es8326: codec@19 {
        compatible = "everest,es8326";
        reg = <0x19>;
        clocks = <&clks 10>;
        clock-names = "mclk";
        #sound-dai-cells = <0>;
        mic1-src = [22];
        mic2-src = [44];
        amic1-src = [19];
        amic2-src = [19];
        jack-pol = [0e];
      };
    };
```

## Documentation/devicetree/bindings/sound/hifiberry-dacpro.yaml
```yaml
# SPDX-License-Identifier: GPL-2.0
%YAML 1.2
---
$id: http://devicetree.org/schemas/sound/hifiberry-dacpro.yaml#
$schema: http://devicetree.org/meta-schemas/core.yaml#

title: Hifiberry DAC+ Pro clock driver

maintainers:
  - Pierre-Louis Bossart <pierre-louis.bossart@linux.intel.com>

description: |
  The Hifiberry DAC+ PRO provides two oscillators for enhanced audio
  quality. The clk driver allow for select and configuration of the
  clock source.

properties:
  "#clock-cells":
    const: 0

  compatible:
    items:
      - const: hifiberry,dacpro-clk
  reg:
    maxItems: 1

required:
  - "#clock-cells"
  - compatible

examples:
  - |
    dacpro_osc: dacpro_osc {
        compatible = "hifiberry,dacpro-clk";
        #clock-cells = <0>;
    };

...
```

## arch/arm64/configs/snd_defconfig
```kconfig
CONFIG_COMPILE_TEST=y
CONFIG_SYSVIPC=y
CONFIG_POSIX_MQUEUE=y
CONFIG_USELIB=y
CONFIG_AUDIT=y
CONFIG_NO_HZ_IDLE=y
CONFIG_HIGH_RES_TIMERS=y
CONFIG_PREEMPT=y
CONFIG_BSD_PROCESS_ACCT=y
CONFIG_BSD_PROCESS_ACCT_V3=y
CONFIG_TASKSTATS=y
CONFIG_TASK_DELAY_ACCT=y
CONFIG_TASK_XACCT=y
CONFIG_TASK_IO_ACCOUNTING=y
CONFIG_IKCONFIG=y
CONFIG_IKCONFIG_PROC=y
CONFIG_LOG_BUF_SHIFT=21
CONFIG_NUMA_BALANCING=y
CONFIG_MEMCG=y
CONFIG_MEMCG_SWAP=y
# CONFIG_UTS_NS is not set
# CONFIG_IPC_NS is not set
# CONFIG_NET_NS is not set
CONFIG_SCHED_AUTOGROUP=y
CONFIG_BLK_DEV_INITRD=y
# CONFIG_COMPAT_BRK is not set
CONFIG_PROFILING=y
CONFIG_ARCH_RENESAS=y
CONFIG_ARCH_STRATIX10=y
# CONFIG_CAVIUM_ERRATUM_22375 is not set
# CONFIG_CAVIUM_ERRATUM_23154 is not set
# CONFIG_CAVIUM_ERRATUM_27456 is not set
CONFIG_ARM64_VA_BITS_48=y
CONFIG_SCHED_MC=y
CONFIG_NUMA=y
CONFIG_COMPAT=y
# CONFIG_ARM64_VHE is not set
CONFIG_CMDLINE="console=ttyAMA0"
# CONFIG_DMI is not set
CONFIG_PM_DEBUG=y
CONFIG_PM_ADVANCED_DEBUG=y
CONFIG_CPU_IDLE=y
CONFIG_CPU_IDLE_GOV_LADDER=y
CONFIG_ARM_CPUIDLE=y
CONFIG_JUMP_LABEL=y
# CONFIG_BLK_DEV_BSG is not set
# CONFIG_CORE_DUMP_DEFAULT_ELF_HEADERS is not set
CONFIG_KSM=y
CONFIG_TRANSPARENT_HUGEPAGE=y
CONFIG_CMA=y
CONFIG_NET=y
CONFIG_PACKET=y
CONFIG_UNIX=y
CONFIG_INET=y
CONFIG_IP_PNP=y
CONFIG_IP_PNP_DHCP=y
# CONFIG_INET_DIAG is not set
# CONFIG_IPV6 is not set
# CONFIG_WIRELESS is not set
CONFIG_PCI=y
CONFIG_PCIEPORTBUS=y
CONFIG_DEVTMPFS=y
CONFIG_DEVTMPFS_MOUNT=y
CONFIG_VEXPRESS_CONFIG=y
CONFIG_BLK_DEV_LOOP=y
# CONFIG_VEXPRESS_SYSCFG is not set
CONFIG_NETDEVICES=y
# CONFIG_NET_VENDOR_3COM is not set
# CONFIG_NET_VENDOR_ADAPTEC is not set
# CONFIG_NET_VENDOR_AGERE is not set
# CONFIG_NET_VENDOR_ALACRITECH is not set
# CONFIG_NET_VENDOR_ALTEON is not set
# CONFIG_NET_VENDOR_AMAZON is not set
# CONFIG_NET_VENDOR_AMD is not set
# CONFIG_NET_VENDOR_AQUANTIA is not set
# CONFIG_NET_VENDOR_ARC is not set
# CONFIG_NET_VENDOR_ATHEROS is not set
# CONFIG_NET_VENDOR_BROADCOM is not set
# CONFIG_NET_VENDOR_BROCADE is not set
# CONFIG_NET_VENDOR_CAVIUM is not set
# CONFIG_NET_VENDOR_CHELSIO is not set
# CONFIG_NET_VENDOR_CISCO is not set
# CONFIG_NET_VENDOR_DEC is not set
# CONFIG_NET_VENDOR_DLINK is not set
# CONFIG_NET_VENDOR_EMULEX is not set
# CONFIG_NET_VENDOR_EZCHIP is not set
# CONFIG_NET_VENDOR_HISILICON is not set
# CONFIG_NET_VENDOR_HP is not set
# CONFIG_NET_VENDOR_INTEL is not set
# CONFIG_NET_VENDOR_MARVELL is not set
# CONFIG_NET_VENDOR_MELLANOX is not set
# CONFIG_NET_VENDOR_MICREL is not set
# CONFIG_NET_VENDOR_MYRI is not set
# CONFIG_NET_VENDOR_NATSEMI is not set
# CONFIG_NET_VENDOR_NETRONOME is not set
# CONFIG_NET_VENDOR_NVIDIA is not set
# CONFIG_NET_VENDOR_OKI is not set
# CONFIG_NET_VENDOR_QLOGIC is not set
# CONFIG_NET_VENDOR_QUALCOMM is not set
# CONFIG_NET_VENDOR_RDC is not set
# CONFIG_NET_VENDOR_REALTEK is not set
CONFIG_RAVB=y
# CONFIG_NET_VENDOR_ROCKER is not set
# CONFIG_NET_VENDOR_SAMSUNG is not set
# CONFIG_NET_VENDOR_SEEQ is not set
# CONFIG_NET_VENDOR_SOLARFLARE is not set
# CONFIG_NET_VENDOR_SILAN is not set
# CONFIG_NET_VENDOR_SIS is not set
# CONFIG_NET_VENDOR_SMSC is not set
# CONFIG_NET_VENDOR_STMICRO is not set
# CONFIG_NET_VENDOR_SUN is not set
# CONFIG_NET_VENDOR_SYNOPSYS is not set
# CONFIG_NET_VENDOR_TEHUTI is not set
# CONFIG_NET_VENDOR_TI is not set
# CONFIG_NET_VENDOR_VIA is not set
# CONFIG_NET_VENDOR_WIZNET is not set
# CONFIG_WLAN is not set
# CONFIG_INPUT_KEYBOARD is not set
# CONFIG_INPUT_MOUSE is not set
# CONFIG_SERIO is not set
CONFIG_LEGACY_PTY_COUNT=16
CONFIG_SERIAL_SH_SCI=y
CONFIG_SERIAL_XILINX_PS_UART=y
CONFIG_SERIAL_XILINX_PS_UART_CONSOLE=y
# CONFIG_HW_RANDOM is not set
# CONFIG_I2C_COMPAT is not set
CONFIG_I2C_CHARDEV=y
CONFIG_I2C_MUX=y
CONFIG_I2C_MUX_PCA954x=y
CONFIG_I2C_DESIGNWARE_PLATFORM=y
CONFIG_I2C_DESIGNWARE_SLAVE=y
CONFIG_I2C_RK3X=y
CONFIG_I2C_SH_MOBILE=y
CONFIG_I2C_RCAR=y
CONFIG_GPIO_RCAR=y
CONFIG_GPIO_PCA953X=y
CONFIG_GPIO_UCB1400=y
CONFIG_POWER_RESET_VEXPRESS=y
CONFIG_POWER_RESET_SYSCON=y
# CONFIG_HWMON is not set
CONFIG_UCB1400_CORE=y
# CONFIG_ABX500_CORE is not set
CONFIG_MEDIA_SUPPORT=y
CONFIG_MEDIA_CAMERA_SUPPORT=y
CONFIG_MEDIA_CONTROLLER=y
CONFIG_VIDEO_V4L2_SUBDEV_API=y
CONFIG_V4L_PLATFORM_DRIVERS=y
CONFIG_V4L_MEM2MEM_DRIVERS=y
CONFIG_VIDEO_RENESAS_FCP=y
CONFIG_VIDEO_RENESAS_VSP1=y
CONFIG_V4L_TEST_DRIVERS=y
CONFIG_VIDEO_VIVID=y
# CONFIG_MEDIA_SUBDRV_AUTOSELECT is not set
CONFIG_DRM=y
CONFIG_DRM_RCAR_DU=y
CONFIG_DRM_RCAR_DW_HDMI=y
CONFIG_DRM_PANEL_LVDS=y
CONFIG_DRM_DUMB_VGA_DAC=y
CONFIG_DRM_LVDS_ENCODER=y
CONFIG_DRM_TI_TFP410=y
CONFIG_DRM_DW_HDMI_I2S_AUDIO=y
CONFIG_FB_MODE_HELPERS=y
# CONFIG_LCD_CLASS_DEVICE is not set
# CONFIG_BACKLIGHT_GENERIC is not set
CONFIG_LOGO=y
# CONFIG_LOGO_LINUX_MONO is not set
# CONFIG_LOGO_LINUX_VGA16 is not set
CONFIG_SOUND=y
CONFIG_SND=y
# CONFIG_SND_SUPPORT_OLD_API is not set
# CONFIG_SND_VERBOSE_PROCFS is not set
CONFIG_SND_AC97_POWER_SAVE=y
# CONFIG_SND_PCI is not set
CONFIG_SND_SOC=y
CONFIG_SND_SOC_RCAR=y
CONFIG_SND_SOC_AC97_CODEC=y
CONFIG_SND_SOC_AK4613=y
CONFIG_SND_SOC_BT_SCO=y
CONFIG_SND_SOC_CS42XX8_I2C=y
CONFIG_SND_SOC_PCM3168A_I2C=y
CONFIG_SND_SOC_WM8960=y
CONFIG_SND_SIMPLE_CARD=y
CONFIG_SND_AUDIO_GRAPH_CARD=y
# CONFIG_HID_GENERIC is not set
# CONFIG_HID_A4TECH is not set
# CONFIG_HID_APPLE is not set
# CONFIG_HID_BELKIN is not set
# CONFIG_HID_CHERRY is not set
# CONFIG_HID_CHICONY is not set
# CONFIG_HID_CYPRESS is not set
# CONFIG_HID_EZKEY is not set
# CONFIG_HID_KENSINGTON is not set
# CONFIG_HID_LOGITECH is not set
# CONFIG_HID_MICROSOFT is not set
# CONFIG_HID_MONTEREY is not set
# CONFIG_USB_SUPPORT is not set
CONFIG_RTC_CLASS=y
CONFIG_DMADEVICES=y
CONFIG_MV_XOR_V2=y
# CONFIG_SH_DMAE_BASE is not set
CONFIG_RCAR_DMAC=y
CONFIG_COMMON_CLK_VERSATILE=y
CONFIG_CLK_SP810=y
CONFIG_CLK_VEXPRESS_OSC=y
CONFIG_COMMON_CLK_CS2000_CP=y
CONFIG_CLK_QORIQ=y
CONFIG_COMMON_CLK_VC5=y
# CONFIG_FSL_ERRATUM_A008585 is not set
CONFIG_ARM_SMMU=y
CONFIG_ARM_SMMU_V3=y
CONFIG_ARCH_R8A7795=y
CONFIG_ARCH_R8A7796=y
# CONFIG_ARM_PMU is not set
# CONFIG_MANDATORY_FILE_LOCKING is not set
# CONFIG_DNOTIFY is not set
# CONFIG_INOTIFY_USER is not set
# CONFIG_EFIVAR_FS is not set
# CONFIG_MISC_FILESYSTEMS is not set
CONFIG_NFS_FS=y
CONFIG_ROOT_NFS=y
CONFIG_NLS=y
CONFIG_NLS_CODEPAGE_437=y
CONFIG_NLS_ISO8859_1=y
CONFIG_DMA_CMA=y
CONFIG_CMA_SIZE_MBYTES=128
CONFIG_PRINTK_TIME=y
CONFIG_MAGIC_SYSRQ=y
CONFIG_DEBUG_KERNEL=y
CONFIG_DETECT_HUNG_TASK=y
# CONFIG_SCHED_DEBUG is not set
# CONFIG_DEBUG_PREEMPT is not set
CONFIG_PROVE_LOCKING=y
CONFIG_FUNCTION_TRACER=y
CONFIG_IRQSOFF_TRACER=y
CONFIG_MEMTEST=y
```

## sound/soc/sdca/Kconfig
```kconfig
# SPDX-License-Identifier: GPL-2.0-only

config SND_SOC_SDCA
	tristate "ASoC SDCA library"
	depends on ACPI
	select AUXILIARY_BUS
	help
	  This option enables support for the MIPI SoundWire Device
	  Class for Audio (SDCA).

config SND_SOC_SDCA_OPTIONAL
	def_tristate SND_SOC_SDCA || !SND_SOC_SDCA

config SND_SOC_SDCA_SMART_AMP
	tristate "ASoC SDCA SmartAmp driver"
	depends on SND_SOC_SDCA
	help
	  This option enables support for the MIPI SDCA SmartAmp Function driver.

config SND_SOC_SDCA_UAJ
	tristate "ASoC SDCA UAJ"
	depends on SND_SOC_SDCA
	help
	  This option enables support for the MIPI SDCA Universal Audio Jack
	  Function driver.

config SND_SOC_SDCA_SMART_MIC
	tristate "ASoC SDCA SmartMic driver"
	depends on SND_SOC_SDCA
	help
	  This option enables support for the MIPI SDCA SmartMic Function driver.

config SND_SOC_SDCA_HID
	tristate "ASoC SDCA HID driver"
	depends on SND_SOC_SDCA
	help
	  This option enables support for the MIPI SDCA HID Function driver.
```
